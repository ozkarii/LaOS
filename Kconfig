## Kconfig
```kconfig
mainmenu "LaOS Configuration"

source "src/kernel/fs/Kconfig"
source "src/kernel/memory/Kconfig"
source "src/kernel/system/Kconfig"

source "src/kernel/utils/Kconfig"
```

## config/defconfig
```kconfig
#
# Filesystem
#
CONFIG_FS_VFS_MAX_OPEN_FILES=64
CONFIG_FS_VFS_MAX_MOUNTS=8
CONFIG_FS_RAMFS_MAX_FILE_SIZE=0x80000
CONFIG_FS_RAMFS_MAX_FILES=16
CONFIG_FS_RAMFS_MAX_FILE_HANDLES=16
CONFIG_FS_RAMFS_MAX_CHILDREN=8
# end of Filesystem

#
# Memory
#
CONFIG_MEMORY_OBJECT_SIZE_SMALL=0x100
CONFIG_MEMORY_OBJECT_SIZE_MEDIUM=0x1000
CONFIG_MEMORY_OBJECT_SIZE_LARGE=0x200000
CONFIG_MEMORY_NUM_OBJECTS_SMALL=128
CONFIG_MEMORY_NUM_OBJECTS_MEDIUM=32
CONFIG_MEMORY_NUM_OBJECTS_LARGE=16
# end of Memory

#
# Processes
#
CONFIG_SYSTEM_PROCESS_MAX_PROCESSES=64
CONFIG_SYSTEM_PROCESS_MAX_OPEN_FDS=16
CONFIG_SYSTEM_PROCESS_MAX_VIRTUAL_MEMORY_MAPPINGS=16
# end of Processes

#
# Tasks and Scheduling
#
CONFIG_SYSTEM_MAX_TASKS=32
CONFIG_SYSTEM_SCHED_KERNEL_TASK_STACK_SIZE=0x4000
CONFIG_SYSTEM_SCHED_TASK_TIME_SLICE_US=10000
# end of Tasks and Scheduling

#
# Misc
#
CONFIG_UTILS_PATH_NAME_MAX=64
# end of Misc
```

## src/kernel/fs/Kconfig
```kconfig
menu "Filesystem"

config FS_VFS_MAX_OPEN_FILES
    int "VFS max open files"
    default 64
    help
      Upper bound on the number of files that can be open at once
      in the virtual file system.

config FS_VFS_MAX_MOUNTS
    int "VFS max mount points"
    default 8
    help
      Upper bound on the number of mount points that can be registered
      in the virtual file system.

config FS_RAMFS_MAX_FILE_SIZE
    hex "RamFS max file size"
    default 0x80000
    help
      Upper bound on the size of any single file stored in the
      in-memory ramfs.

config FS_RAMFS_MAX_FILES
    int "RamFS max files"
    default 16
    help
      Total number of file slots (including directories) available
      in the in-memory ramfs.

config FS_RAMFS_MAX_FILE_HANDLES
    int "RamFS max open files"
    default 16
    help
      Maximum number of files that can be open in the ramfs at once.

config FS_RAMFS_MAX_CHILDREN
    int "RamFS max children per directory"
    default 8
    help
      Maximum number of direct children a single directory in the
      ramfs can have.

endmenu
```

## src/kernel/memory/Kconfig
```kconfig
menu "Memory"

config MEMORY_OBJECT_SIZE_SMALL
	hex "Kernel malloc small object size"
	default 0x100

config MEMORY_OBJECT_SIZE_MEDIUM
	hex "Kernel malloc medium object size"
	default 0x1000

config MEMORY_OBJECT_SIZE_LARGE
	hex "Kernel malloc large object size"
	default 0x200000

config MEMORY_NUM_OBJECTS_SMALL
	int "Number of small allocator objects"
	default 128

config MEMORY_NUM_OBJECTS_MEDIUM
	int "Number of medium allocator objects"
	default 32

config MEMORY_NUM_OBJECTS_LARGE
	int "Number of large allocator objects"
	default 16

endmenu
```

## src/kernel/system/Kconfig
```kconfig
menu "Processes"

config SYSTEM_PROCESS_MAX_PROCESSES
    int "Maximum number of processes"
    default 64
    help
      Maximum number of processes that can be created in the system.

config SYSTEM_PROCESS_MAX_OPEN_FDS
    int "Maximum number of open file descriptors per process"
    default 16
    help
      Maximum number of open file descriptors that a process can have.

config SYSTEM_PROCESS_MAX_VIRTUAL_MEMORY_MAPPINGS
    int "Maximum number of virtual memory mappings per process"
    default 16
    help
      Maximum number of virtual memory mappings that a process can have.

endmenu

menu "Tasks and Scheduling"

config SYSTEM_MAX_TASKS
    int "Maximum number of tasks"
    default 32
    help
      Maximum number of tasks that can be created in the system.

config SYSTEM_SCHED_KERNEL_TASK_STACK_SIZE
    hex "Kernel task stack size"
    default 0x4000
    help
      Size of the stack allocated for each kernel task.

config SYSTEM_SCHED_TASK_TIME_SLICE_US
    int "Scheduler time slice (microseconds)"
    default 100000
    help
      Time slice for each task in microseconds.

endmenu
```

## src/kernel/utils/Kconfig
```kconfig
menu "Misc"

config UTILS_PATH_NAME_MAX
    int "Maximum length of a path name"
    default 64
    help
      Maximum number of characters (including the terminating NUL)
      in any path handled by the kernel's path utilities.

endmenu
```
