ENTRY(_start)

SECTIONS
{
    /* Executable */
    . = 0x1000; /* Start from offset of 4 KB */

    .text : {
        *(.text .text.*)
    }

    .rodata : {
        *(.rodata .rodata.*)
    }

    .data : {
        *(.data .data.*)
    }

    .bss : {
        *(.bss .bss.*)
        *(COMMON)
    }
}